## arch/arm/configs/novaler4k_defconfig
```kconfig
# Hardware Support
CONFIG_ARCH_HISI=y
CONFIG_ARCH_HI3798MV200=y
CONFIG_SMP=y
CONFIG_ARM_PSCI=y

# Ethernet (STMMAC) - Crucial for OpenWrt
CONFIG_STMMAC_ETH=y
CONFIG_STMMAC_PLATFORM=y
CONFIG_DWMAC_HISI=y

# LEDs & GPIO (For Red/Green/Yellow Status)
CONFIG_NEW_LEDS=y
CONFIG_LEDS_CLASS=y
CONFIG_LEDS_GPIO=y
CONFIG_LEDS_TRIGGERS=y
CONFIG_LEDS_TRIGGER_NETDEV=y

# Remote Control (IR)
CONFIG_RC_CORE=y
CONFIG_RC_DECODERS=y
CONFIG_IR_HISI=y

# OpenWrt Optimization (Minimalist)
# CONFIG_MEDIA_SUPPORT is not set
# CONFIG_DVB_CORE is not set
# CONFIG_SOUND is not set
CONFIG_NETFILTER=y
CONFIG_BRIDGE=y
CONFIG_VLAN_8021Q=y
CONFIG_OVERLAY_FS=y
CONFIG_SQUASHFS=y
```
